## components/telegram_bot/Kconfig.projbuild
```kconfig
menu "Telegram Bot Configuration"

    config TELEGRAM_BOT_API_KEY
        string "Telegram Bot API key"
        default "bot key"
        help
            API key for Telegram Bot

    config TELEGRAM_BOT_ADMIN_ID
        string "Bot Admin"
        default "12345"
        help
            ID for the bot admin

endmenu
```
